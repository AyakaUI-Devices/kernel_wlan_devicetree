&wlan_vendor_wonder {
    status = "okay";
};

&soc {
    wonder_node: wonder-device {
        compatible = "google,wonder-drv-v1";
        // This is important to link vendor label to wondertap-provider.
        wondertap-provider = <&wlan_vendor_wonder>;
        status = "okay";
    };
};
